#include "ssd1306.h"
#include "pico/stdlib.h"
#include <string.h>

// 5x7 字体数据
static const uint8_t font5x7[][5] = {
    {0x00, 0x00, 0x00, 0x00, 0x00}, // 0x20 (space)
    {0x00, 0x00, 0x5F, 0x00, 0x00}, // 0x21 (!)
    {0x00, 0x07, 0x00, 0x07, 0x00}, // 0x22 (")
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    {0x00, 0x00, 0x0D, 0x14, 0x18}, // 0x7A (z)
};

static void ssd1306_command(ssd1306_t *dev, uint8_t cmd) {
    uint8_t buf[2] = {0x00, cmd};  // 0x00 = 命令模式
    i2c_write_blocking(dev->i2c_port, dev->i2c_addr, buf, 2, false);
}

static void ssd1306_data(ssd1306_t *dev, uint8_t data) {
    uint8_t buf[2] = {0x40, data};  // 0x40 = 数据模式
    i2c_write_blocking(dev->i2c_port, dev->i2c_addr, buf, 2, false);
}

int ssd1306_init(ssd1306_t *dev, i2c_inst_t *i2c_port, uint8_t i2c_addr) {
    dev->i2c_port = i2c_port;
    dev->i2c_addr = i2c_addr;
    dev->contrast = 0x7F;
    memset(dev->buffer, 0, SSD1306_BUFFER_SIZE);

    // 小延时等待屏幕稳定
    sleep_ms(10);

    // 初始化序列
    ssd1306_command(dev, SSD1306_CMD_DISPLAY_OFF);
    ssd1306_command(dev, SSD1306_CMD_SET_CLK_DIV);
    ssd1306_command(dev, 0x80);
    ssd1306_command(dev, SSD1306_CMD_SET_MUX_RATIO);
    ssd1306_command(dev, SSD1306_HEIGHT - 1);
    ssd1306_command(dev, SSD1306_CMD_SET_DISPLAY_OFFSET);
    ssd1306_command(dev, 0x00);
    ssd1306_command(dev, SSD1306_CMD_SET_START_LINE | 0x00);
    ssd1306_command(dev, SSD1306_CMD_CHARGE_PUMP);
    ssd1306_command(dev, 0x14);  // 启用电荷泵
    ssd1306_command(dev, SSD1306_CMD_MEMORY_MODE);
    ssd1306_command(dev, 0x00);  // 水平寻址模式
    ssd1306_command(dev, SSD1306_CMD_SET_SEGMENT_REMAP | 0x01);
    ssd1306_command(dev, SSD1306_CMD_SET_COM_SCAN_DEC);
    ssd1306_command(dev, SSD1306_CMD_SET_COM_PINS);
    ssd1306_command(dev, 0x02);
    ssd1306_command(dev, SSD1306_CMD_SET_CONTRAST);
    ssd1306_command(dev, dev->contrast);
    ssd1306_command(dev, SSD1306_CMD_SET_PRECHARGE);
    ssd1306_command(dev, 0xF1);
    ssd1306_command(dev, SSD1306_CMD_SET_VCOMH);
    ssd1306_command(dev, 0x40);
    ssd1306_command(dev, SSD1306_CMD_DISPLAY_ALL_ON_RES);
    ssd1306_command(dev, SSD1306_CMD_NORMAL_DISPLAY);
    ssd1306_command(dev, SSD1306_CMD_DISPLAY_ON);

    return 0;
}

void ssd1306_display_on(ssd1306_t *dev) {
    ssd1306_command(dev, SSD1306_CMD_DISPLAY_ON);
}

void ssd1306_display_off(ssd1306_t *dev) {
    ssd1306_command(dev, SSD1306_CMD_DISPLAY_OFF);
}

void ssd1306_set_contrast(ssd1306_t *dev, uint8_t contrast) {
    dev->contrast = contrast;
    ssd1306_command(dev, SSD1306_CMD_SET_CONTRAST);
    ssd1306_command(dev, contrast);
}

void ssd1306_clear(ssd1306_t *dev) {
    memset(dev->buffer, 0, SSD1306_BUFFER_SIZE);
}

void ssd1306_fill(ssd1306_t *dev, uint8_t color) {
    uint8_t value = color ? 0xFF : 0x00;
    memset(dev->buffer, value, SSD1306_BUFFER_SIZE);
}

void ssd1306_set_pixel(ssd1306_t *dev, int16_t x, int16_t y, uint8_t color) {
    if (x < 0 || x >= SSD1306_WIDTH || y < 0 || y >= SSD1306_HEIGHT) {
        return;
    }
    uint16_t index = x + (y / 8) * SSD1306_WIDTH;
    if (color) {
        dev->buffer[index] |= (1 << (y % 8));
    } else {
        dev->buffer[index] &= ~(1 << (y % 8));
    }
}

void ssd1306_show(ssd1306_t *dev) {
    // 设置列地址
    ssd1306_command(dev, SSD1306_CMD_COLUMN_ADDR);
    ssd1306_command(dev, 0);
    ssd1306_command(dev, SSD1306_WIDTH - 1);

    // 设置页地址
    ssd1306_command(dev, SSD1306_CMD_PAGE_ADDR);
    ssd1306_command(dev, 0);
    ssd1306_command(dev, (SSD1306_HEIGHT / 8) - 1);

    // 写入数据
    uint8_t header = 0x40;  // 数据模式
    i2c_write_blocking(dev->i2c_port, dev->i2c_addr, &header, 1, true);
    i2c_write_blocking(dev->i2c_port, dev->i2c_addr, dev->buffer, SSD1306_BUFFER_SIZE, false);
}

void ssd1306_fill_rect(ssd1306_t *dev, int16_t x, int16_t y, int16_t w, int16_t h, uint8_t color) {
    for (int16_t i = x; i < x + w; i++) {
        for (int16_t j = y; j < y + h; j++) {
            ssd1306_set_pixel(dev, i, j, color);
        }
    }
}

void ssd1306_draw_line(ssd1306_t *dev, int16_t x0, int16_t y0, int16_t x1, int16_t y1, uint8_t color) {
    int16_t dx = x1 - x0, dy = y1 - y0;
    int16_t sx = dx > 0 ? 1 : -1, sy = dy > 0 ? 1 : -1;
    dx = dx > 0 ? dx : -dx;
    dy = dy > 0 ? dy : -dy;

    if (dx > dy) {
        int16_t err = dx / 2;
        while (x0 != x1) {
            ssd1306_set_pixel(dev, x0, y0, color);
            err -= dy;
            if (err < 0) {
                y0 += sy;
                err += dx;
            }
            x0 += sx;
        }
    } else {
        int16_t err = dy / 2;
        while (y0 != y1) {
            ssd1306_set_pixel(dev, x0, y0, color);
            err -= dx;
            if (err < 0) {
                x0 += sx;
                err += dy;
            }
            y0 += sy;
        }
    }
    ssd1306_set_pixel(dev, x1, y1, color);
}

void ssd1306_draw_char(ssd1306_t *dev, int16_t x, int16_t y, char ch, uint8_t color) {
    if (ch < 0x20 || ch > 0x7F) {
        ch = 0x20;  // 显示空格
    }
    const uint8_t *glyph = font5x7[ch - 0x20];
    for (int i = 0; i < 5; i++) {
        uint8_t col = glyph[i];
        for (int j = 0; j < 8; j++) {
            if (y + j < SSD1306_HEIGHT) {
                ssd1306_set_pixel(dev, x + i, y + j, color ? (col & (1 << j)) : !(col & (1 << j)));
            }
        }
    }
}

void ssd1306_draw_string(ssd1306_t *dev, int16_t x, int16_t y, const char *str, uint8_t color) {
    while (*str) {
        ssd1306_draw_char(dev, x, y, *str, color);
        x += 6;  // 每个字符 5 像素 + 1 像素间距
        str++;
    }
}
